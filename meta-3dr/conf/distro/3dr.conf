## meta-3dr/conf/distro/3dr.conf
```bitbake
DISTRO = "3dr"
DISTRO_NAME = "3DR Poky (based on Yocto Project Reference Distro)"
DISTRO_VERSION = "1.5.1"

LOCALCONF_VERSION = "1"
LAYER_CONF_VERSION ?= "6"

include conf/distro/poky/poky.conf

#
# OELAYOUT_ABI allows us to notify users when the format of TMPDIR changes in
# an incompatible way. Such changes should usually be detailed in the commit
# that breaks the format and have been previously discussed on the mailing list
# with general agreement from the core team.
#
OELAYOUT_ABI = "8"

DISTRO_FEATURES_remove = " pulseaudio alsa bluetooth irda pcmcia nfs zeroconf 3g nfc x11 opengl wayland"
```

## meta-3dr/conf/layer.conf
```bitbake
# We have a conf and classes directory, add to BBPATH
BBPATH .= ":${LAYERDIR}"

# We have a packages directory, add to BBFILES
BBFILES += "${LAYERDIR}/recipes-*/*/*.bb \
            ${LAYERDIR}/recipes-*/*/*.bbappend"

BBFILE_COLLECTIONS += "3dr"
BBFILE_PATTERN_3dr := "^${LAYERDIR}/"
BBFILE_PRIORITY_3dr = "6"

# exclude vim from oe, for now. 
BBMASK += "/meta-oe/recipes-support/vim*"
```

## meta-3dr/conf/machine/imx6solo-3dr-1080p.conf
```bitbake
#@TYPE: Machine
#@NAME: 3DR HDTC 
#@SOC: i.MX6S
#@DESCRIPTION: Machine configuration for 3DR HDTC with 16-bit video bus

require conf/machine/include/imx6sabresd-common.inc

SOC_FAMILY = "mx6:mx6s"

MACHINE_FEATURES = "pci wifi usbgadget usbhost vfat serial"

FSL_KERNEL_DEFCONFIG = "imx6solo_solo_defconfig"

KERNEL_DEVICETREE = "imx6solo-3dr-1080p.dtb"

PREFERRED_PROVIDER_u-boot = "u-boot-imx"

UBOOT_CONFIG ??= "sd"
UBOOT_CONFIG[sd] = "3dr_hdtc_1080p_config,sdcard"

INITRAMFS_FSTYPES ?= "cpio.gz"
KERNEL_IMAGETYPE ?= "uImage"
INITRAMFS_IMAGE_BUNDLE = "1"

USE_VT = "0"
SERIAL_CONSOLES = ""

SOLOLINK_CONFIG_DIR = "/etc"
```

## meta-3dr/conf/machine/imx6solo-3dr-artoo.conf
```bitbake
#@TYPE: Machine
#@NAME: 3DR HDTC 
#@SOC: i.MX6S
#@DESCRIPTION: Machine configuration for 3DR HDTC

require conf/machine/include/imx6sabresd-common.inc

SOC_FAMILY = "mx6:mx6s"

MACHINE_FEATURES = "pci wifi usbgadget usbhost vfat serial"

FSL_KERNEL_DEFCONFIG = "imx6solo_artoo_defconfig"

KERNEL_DEVICETREE = "imx6solo-3dr-artoo.dtb"

PREFERRED_PROVIDER_u-boot = "u-boot-imx"

UBOOT_CONFIG ??= "sd"
UBOOT_CONFIG[sd] = "3dr_hdtc_artoo_config,sdcard"

INITRAMFS_FSTYPES ?= "cpio.gz"
KERNEL_IMAGETYPE ?= "uImage"
INITRAMFS_IMAGE_BUNDLE = "1"

USE_VT = "0"
SERIAL_CONSOLES = ""

SOLOLINK_CONFIG_DIR = "/etc"
```

## solo-builder/3dr-yocto-bsp-base/conf/bblayers.conf
```bitbake
LCONF_VERSION = "6"

BBPATH = "${TOPDIR}"
BSPDIR := "${@os.path.abspath(os.path.dirname(d.getVar('FILE', True)) + '/../..')}"

BBFILES ?= ""
BBLAYERS = " \
  ${BSPDIR}/sources/poky/meta \
  ${BSPDIR}/sources/poky/meta-yocto \
  \
  ${BSPDIR}/sources/meta-openembedded/meta-oe \
  ${BSPDIR}/sources/meta-openembedded/meta-networking \
  ${BSPDIR}/sources/meta-openembedded/meta-multimedia \
  \
  ${BSPDIR}/sources/meta-fsl-arm \
  ${BSPDIR}/sources/meta-fsl-arm-extra \
  ${BSPDIR}/sources/meta-fsl-demos \
  \
  ${BSPDIR}/sources/meta-3dr \
"
##Freescale Yocto Release layer
BBLAYERS += " ${BSPDIR}/sources/meta-fsl-bsp-release/imx/meta-fsl-arm "
BBLAYERS += " ${BSPDIR}/sources/meta-fsl-bsp-release/imx/meta-fsl-demos "
BBLAYERS += " ${BSPDIR}/sources/meta-browser "
BBLAYERS += " ${BSPDIR}/sources/meta-openembedded/meta-gnome "
BBLAYERS += " ${BSPDIR}/sources/meta-openembedded/meta-networking "
```
